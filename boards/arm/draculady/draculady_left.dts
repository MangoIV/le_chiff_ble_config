#include "draculady.dtsi"

&kscan0 {
    col-gpios
        = <&gpio0 26 GPIO_ACTIVE_HIGH>
        , <&gpio0  4 GPIO_ACTIVE_HIGH>
        , <&gpio0  6 GPIO_ACTIVE_HIGH>
        , <&gpio0  8 GPIO_ACTIVE_HIGH>
        , <&gpio1  9 GPIO_ACTIVE_HIGH>
};
