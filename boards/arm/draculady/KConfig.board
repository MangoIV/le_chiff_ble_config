## boards/arm/draculady/KConfig.board
```kconfig
# Draculady board configuration

# Copyright (c) 2020 @MangoIV
# SPDX-License-Identifier: MIT


if BOARD_DRACULADY_RIGHT

config ZMK_KEYBOARD_NAME
    default "Draculady"

config ZMK_SPLIT_BLE_ROLE_CENTRAL
    default y

endif

if BOARD_DRACULADY_LEFT

config ZMK_KEYBOARD_NAME
    default "Draculady Left"

endif

if BOARD_DRACULADY_LEFT || BOARD_DRACULADY_RIGHT

config ZMK_SPLIT
    default y

config BOARD_DRACULADY
	bool "DracuLady"
	depends on SOC_NRF52840_QIAA

endif
```

## boards/arm/draculady/Kconfig.board
```kconfig
# Draculady board configuration

# Copyright (c) 2020 @MangoIV
# SPDX-License-Identifier: MIT

config BOARD_DRACULADY_RIGHT
	bool "Draculady"
	depends on SOC_NRF52840_QIAA

config BOARD_DRACULADY_LEFT
	bool "Draculady"
	depends on SOC_NRF52840_QIAA
```

## boards/arm/draculady/Kconfig.defconfig
```kconfig
if BOARD_DRACULADY_RIGHT

config ZMK_KEYBOARD_NAME
    default "Draculady"

config ZMK_SPLIT_BLE_ROLE_CENTRAL
    default y

endif

if BOARD_DRACULADY_LEFT

config ZMK_KEYBOARD_NAME
    default "Draculady Left"

endif

if BOARD_DRACULADY_LEFT || BOARD_DRACULADY_RIGHT

config BOARD
	default "draculady"

config ZMK_SPLIT
    default y

if USB

config USB_NRFX
	default y

config USB_DEVICE_STACK
	default y

endif # USB

config BT_CTLR
	default BT

config ZMK_BLE
	default y

config ZMK_USB
	default y

config ZMK_BATTERY_VOLTAGE_DIVIDER
	default y


endif
```

## config/boards/arm/le_chiff_ble/Kconfig
```kconfig
# Copyright (c) 2021 @MangoIV
# SPDX-License-Identifier: MIT

config BOARD_ENABLE_DCDC
	bool "Enable DCDC mode"
	select SOC_DCDC_NRF52X
	default y
	depends on BOARD_LE_CHIFF_BLE
```

## config/boards/arm/le_chiff_ble/Kconfig.board
```kconfig
# Copyright (c) 2021 @MangoIV
# SPDX-License-Identifier: MIT

config BOARD_LE_CHIFF_BLE
	bool "le_chiff_ble"
	depends on SOC_NRF52840_QIAA
```

## west.yml
```yaml
manifest:
  remotes:
    - name: zmkfirmware
      url-base: https://github.com/zmkfirmware
    - name: petejohanson
      url-base: https://github.com/MangoIV
  projects:
    - name: zmk
      remote: MangoIV
      revision: zephyr-2.5-lvgl-theme-fixes
      import: app/west.yml
  self:
    path: config
```

## zmk-config/boards/arm/le_chiff_ble/Kconfig.defconfig
```kconfig
# Copyright (c) 2021 @MangoIV
# SPDX-License-Identifier: MIT

if BOARD_LE_CHIFF_BLE

config BOARD
	default "le_chiff_ble"

config ZMK_KEYBOARD_NAME
	default "le_chiff_ble"

if USB

config USB_NRFX
	default y

config USB_DEVICE_STACK
	default y

endif # USB

config BT_CTLR
	default BT

config ZMK_BLE
	default y

config ZMK_USB
	default y

config ZMK_BATTERY_VOLTAGE_DIVIDER
	default y

config ZMK_DISPLAY
    default y

if ZMK_DISPLAY

config I2C
	default y

config SSD1306
	default y

config SSD1306_REVERSE_MODE
	default y


endif # ZMK_DISPLAY

if LVGL

config LV_Z_VDB_SIZE
	default 64

config LV_DPI_DEF
	default 148

config LV_Z_BITS_PER_PIXEL
	default 1

choice LV_COLOR_DEPTH
	default LV_COLOR_DEPTH_1
endchoice

endif # LVGL

endif # BOARD_LE_CHIFF_BLE
```

## zmk-config/boards/arm/le_chiff_ble/le_chiff_ble_defconfig
```kconfig
# Copyright (c) 2021 @MangoIV
# SPDX-License-Identifier: MIT

# SPDX-License-Identifier: MIT

CONFIG_SOC_SERIES_NRF52X=y
CONFIG_SOC_NRF52840_QIAA=y
CONFIG_BOARD_LE_CHIFF_BLE=y

# Enable MPU
CONFIG_ARM_MPU=y

# enable GPIO
CONFIG_GPIO=y


CONFIG_ZMK_DISPLAY=y
# CONFIG_LVGL_USE_THEME_MONO=y

CONFIG_USE_DT_CODE_PARTITION=y

CONFIG_MPU_ALLOW_FLASH_WRITE=y
CONFIG_NVS=y
CONFIG_SETTINGS_NVS=y
CONFIG_FLASH=y
CONFIG_FLASH_PAGE_LAYOUT=y
CONFIG_FLASH_MAP=y

CONFIG_EC11=y
CONFIG_EC11_TRIGGER_GLOBAL_THREAD=y

# Enable deep sleep support
CONFIG_ZMK_SLEEP=y
# Milliseconds of inactivity before entering deep sleep
# 90 minutes
CONFIG_ZMK_IDLE_SLEEP_TIMEOUT=5400000
# Milliseconds of inactivity before entering idle state
# 30 seconds
CONFIG_ZMK_IDLE_TIMEOUT=30000
# Name
CONFIG_ZMK_KEYBOARD_NAME="Le Chiffre BLE"

CONFIG_BUILD_OUTPUT_UF2=y
```
